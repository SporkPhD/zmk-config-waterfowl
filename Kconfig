## Kconfig
```kconfig
config WATERFOWL_SCREENS
    bool "Waterfowl's own OLED screens (src/), drawn for its upright 128x64 panels"
    depends on ZMK_DISPLAY && ZMK_DISPLAY_STATUS_SCREEN_CUSTOM
    default y
    select LV_USE_IMG
    select LV_USE_CANVAS
    select LV_FONT_UNSCII_8
    select LV_FONT_UNSCII_16
    select ZMK_WPM if !ZMK_SPLIT || ZMK_SPLIT_ROLE_CENTRAL
```
